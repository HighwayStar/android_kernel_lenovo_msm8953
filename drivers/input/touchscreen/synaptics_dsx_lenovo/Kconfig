## drivers/input/touchscreen/synaptics_dsx_lenovo/Kconfig
```kconfig
#
# Synaptics DSX touchscreen driver configuration
#

config TOUCHSCREEN_SYNAPTICS_DSX_LENOVO
	bool "Synaptics DSX v2.6 touchscreen"
	default n
	help
	  Say Y here if you have a Synaptics DSX Lenovo variant touchscreen connected
	  to your system.

	  If unsure, say N.

config TOUCHSCREEN_SYNAPTICS_DSX_I2C_LENOVO
	tristate "Synaptics DSX I2C touchscreen (Lenovo)"
	depends on I2C
	help
	  Say Y here if you have a Synaptics DSX I2C touchscreen
	  connected to your system.

	  If unsure, say N.

	  To compile this driver as a module, choose M here: the
	  module will be called synaptics_dsx_i2c.

config TOUCHSCREEN_SYNAPTICS_DSX_RMI_DEV_LENOVO
	tristate "Synaptics DSX touchscreen char device (Lenovo)"
	depends on TOUCHSCREEN_SYNAPTICS_DSX_I2C_LENOVO
	help
	  This enables support for direct register access for Synaptics DSX
	  touchscreens.

config TOUCHSCREEN_SYNAPTICS_DSX_TEST_REPORTING_LENOVO
	tristate "Synaptics DSX touchscreen test reporting (Lenovo)"
	depends on TOUCHSCREEN_SYNAPTICS_DSX_I2C_LENOVO
	help
	  This enables support for test reporting for Synaptics DSX
	  touchscreens.

config TOUCHSCREEN_SYNAPTICS_DSX_FW_UPDATE_LENOVO
	tristate "Synaptics DSX touchscreen firmware update (Lenovo)"
	depends on TOUCHSCREEN_SYNAPTICS_DSX_I2C_LENOVO
	help
	  This enables support for firmware update for Synaptics DSX
	  touchscreens via the MMI design.
```
